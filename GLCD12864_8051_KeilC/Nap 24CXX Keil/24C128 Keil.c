//Program to interface Serial EEPROM AT24C02 with 8051 microcontroller (AT89C51) 

// link at http://www.engineersgarage.com/microcontroller/8051projects/interface-serial-eeprom-24c02-AT89C51-circuit


#include<reg51.h>
#include<intrins.h>   //For using [_nop_()]
sbit sda=P3^5;
sbit scl=P3^4;
bit ack;
sbit led1=P1^1;

unsigned char reead,write,write2,i,j,k, m, n, a, b, c, d, e, f, g, h;
unsigned int temp;
unsigned char code array1[]={
0x00, 0x00, 0xFF, 0xFF, 0xFF, 0xFF, 0xFE, 0x00, 0x00, 0x00, 0x00, 0x7F, 0xFF, 0xFF, 0xFF, 0xFE,
0x00, 0x03, 0xFF, 0xFF, 0xFF, 0xFF, 0xE0, 0x00, 0x00, 0x00, 0x00, 0x0F, 0xFF, 0xFF, 0xFF, 0xE4,
0x00, 0x1F, 0xFF, 0xFF, 0xFF, 0xFF, 0xC0, 0x00, 0x00, 0x00, 0x04, 0x03, 0xFF, 0xFF, 0xFF, 0xFE,
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0x3F, 0xFF, 0xFF, 0xFC, 0x00, 0x00, 0x36, 0x00, 0x00, 0x00, 0xE7, 0xC0, 0x00, 0x3C, 0x80, 0x00,

	};

unsigned char code array2[]={
0x3F, 0xFF, 0xFF, 0xF0, 0x00, 0x00, 0x3F, 0x00, 0x00, 0x00, 0x63, 0xE0, 0x00, 0x1C, 0x00, 0x00,
0x7F, 0xFF, 0xFF, 0xE0, 0x00, 0x00, 0x1D, 0x00, 0x00, 0x00, 0x61, 0xE0, 0x00, 0x1E, 0x40, 0x00,
0x7F, 0xFF, 0xFF, 0xE0, 0x00, 0x00, 0x19, 0x00, 0x00, 0x00, 0x61, 0xA0, 0x00, 0x1E, 0x00, 0x00,
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0xFF, 0xFF, 0xFE, 0x00, 0x00, 0x00, 0x00, 0x00, 0x04, 0x10, 0x18, 0x7C, 0x00, 0x31, 0x90, 0x00,

};


unsigned char code array3[]={

0xFF, 0xFF, 0xFE, 0x00, 0x00, 0x00, 0x00, 0x00, 0x04, 0x00, 0x1C, 0x3C, 0x00, 0x73, 0xF0, 0x00,
0xFF, 0xFF, 0xFE, 0x00, 0x00, 0x00, 0x00, 0x00, 0x02, 0x00, 0x1C, 0x7C, 0x00, 0x73, 0xA0, 0x00,
0xFF, 0xFF, 0xFE, 0x00, 0x00, 0x00, 0x00, 0x10, 0x03, 0x08, 0x0E, 0xFC, 0x00, 0xE3, 0x60, 0x7E,
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0xFF, 0xFF, 0xFF, 0xC0, 0x00, 0x00, 0x20, 0x7C, 0x00, 0x00, 0x00, 0x00, 0x07, 0xFF, 0xFF, 0xFE,
};
	
	unsigned char code array4[]={
0xFF, 0xFF, 0xFF, 0xF0, 0x00, 0x00, 0x00, 0x66, 0x00, 0x00, 0x00, 0x00, 0x0F, 0xFF, 0xFF, 0xFE,
0xFF, 0xFF, 0xFF, 0xE0, 0x00, 0x00, 0x00, 0x27, 0x00, 0x00, 0x00, 0x00, 0x1F, 0xFF, 0xFF, 0xFE,
0xFF, 0xFF, 0xFF, 0xF0, 0x00, 0x00, 0x00, 0x3F, 0x00, 0x00, 0x00, 0x00, 0x1F, 0xFF, 0xFF, 0xFC,
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0xFF, 0xFF, 0xFF, 0xFF, 0xFF, 0xFF, 0xFF, 0xFF, 0xFF, 0xFF, 0xEF, 0xFF, 0xFF, 0xFF, 0xFF, 0xFE
};

void delay(unsigned int count)
{
	int i,j;
	for(i=0;i<count;i++)
		for(j=0;j<1275;j++);
}


void aknowledge()	  //acknowledge condition
{
	scl=1;
	_nop_();
	_nop_();
	scl=0;
} 

/*
void noack()	  //acknowledge condition
{
	sda=0;
	scl=1;
	_nop_();
	_nop_();
	scl=0;
} 
*/

void start()		//start condition
{
	sda=1;
	scl=1;
	_nop_(); //START SETUP TIME    
	_nop_();   
	_nop_();     
	_nop_(); 	
	sda=0;
	_nop_();     //START HOLD TIME
	_nop_(); 
	_nop_();     
	_nop_(); 
	scl=0;
}
void stop()			//stop condition
{
	sda=0;
	scl=1;
	_nop_();
	_nop_(); 
	_nop_();     //STOP HOLD TIME
	_nop_(); 
	sda=1;
	//scl=0;
}
void send_byte(unsigned char value)	//send byte serially
{ 
	unsigned int i;
	unsigned char send;
	send=value;
	for(i=0;i<8;i++)
	{
		sda=send/128;			//extracting MSB
		send=send<<1;			//shiftng left
		scl=1;
		_nop_();
		_nop_();
		scl=0;
	}
   ack=sda;					//reading acknowledge
   sda=0;
}
/*unsigned char read_byte()			//reading from EEPROM serially
{
	unsigned int i;
	sda=1;
	reead=0;
	for(i=0;i<8;i++)
	{
		reead=reead<<1;
		scl=1;
		_nop_();
		_nop_();
		if(sda==1)
			reead++;
		scl=0;
	}
	sda=0;
	return reead;				//Returns 8 bit data here
}	
*/

/*void save()					//send 1 byte into EEPROM
{
	start();
	send_byte(0xA0);						//device address
	aknowledge();
	send_byte(0x00);						//1st word address
	aknowledge();
	send_byte(0x00);						//2nd word address
	aknowledge();
	send_byte(1);							//send 1st data byte
	aknowledge();
	stop();							   
	if(ack==0)
	{
		led1=1;
		delay(100);
		led1=0;
		delay(100);
	}
	else
		led1=1;
	aknowledge();
}
*/
void send64(unsigned char high_addr, unsigned char low_addr, unsigned char *array, unsigned short beginindex)	//send 64 consecutive bytes into EEPROM
{
	start();
	send_byte(0xA0);						//device address
	aknowledge();
	send_byte(high_addr);						//1st word address
	aknowledge();
	send_byte(low_addr);						//2nd word address
	aknowledge();
	
		for(i=0;i<64;i++)
	{
	send_byte(array[i+beginindex]);							//send 1st data byte
	aknowledge();
	}
	
	stop();							   
	if(ack==0)
	{
		led1=1;
		delay(100);
		led1=0;
		delay(100);
	}
	else
		led1=1;
	aknowledge();
}

void send_image(unsigned char high_addr, unsigned char low_addr) //send 16x64 bytes = 1kB into EEPROM
{
	j = 0; m = high_addr; n = low_addr;
	for(k=0;k<4;k++)
	{
		n = (k%4)*64;
		j = k*64;
		send64(m, n, array1, j);
	}
	m++;
	for(k=0;k<4;k++)
	{
		n = (k%4)*64;
		j = k*64;
		send64(m, n, array2, j);
	}
	
	m++;
	for(k=0;k<4;k++)
	{
		n = (k%4)*64;
		j = k*64;
		send64(m, n, array3, j);
	}
	m++;
	for(k=0;k<4;k++)
	{
		n = (k%4)*64;
		j = k*64;
		send64(m, n, array4, j);
	}
	
}


/*void Read()
{
	start();
	send_byte(0xA0);
	aknowledge();
	send_byte(0x00);
	aknowledge();
	send_byte(0x00);
	aknowledge();
	start();
	send_byte(0xA1);					 //device address
	aknowledge();
	a=read_byte();
	aknowledge();
	b=read_byte();
	aknowledge();
	c=read_byte();
	aknowledge();
	d=read_byte();
	aknowledge();
	e=read_byte();
	aknowledge();
	f=read_byte();
	noack();
	stop();
}
*/
void main()
{
	
	temp=0;
	
	send_image(0x2C, 0x00);
	//send64(0x00, 0x80, array, 128);
	//Read();
	//P1 = b;
	while(1)
	{

	}
}